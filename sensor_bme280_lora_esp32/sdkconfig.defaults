## sensor_bme280_lora_esp32/sdkconfig.defaults
```kconfig
CONFIG_ESP_CONSOLE_USB_SERIAL_JTAG=y
CONFIG_ESP_CONSOLE_USB_SERIAL_JTAG_ENABLED=y
CONFIG_ESP_CONSOLE_SECONDARY_NONE=y
CONFIG_ESP_CONSOLE_UART_NUM=-1
CONFIG_ESP_CONSOLE_ROM_SERIAL_PORT_NUM=3

# Task Watchdog: reset the chip on timeout (don't just log) so a wedged,
# unattended sensor recovers itself. The app task subscribes and is patted from
# __SLEEP_MS; see main/app.c.
CONFIG_ESP_TASK_WDT_PANIC=y

# Reproducible build: strip absolute build paths and timestamps so identical
# sources produce a byte-identical binary.
CONFIG_APP_REPRODUCIBLE_BUILD=y
```

## simulator_sensor_lora_esp32/sdkconfig.defaults
```kconfig
CONFIG_ESP_CONSOLE_USB_SERIAL_JTAG=y
CONFIG_ESP_CONSOLE_USB_SERIAL_JTAG_ENABLED=y
CONFIG_ESP_CONSOLE_SECONDARY_NONE=y
CONFIG_ESP_CONSOLE_UART_NUM=-1
CONFIG_ESP_CONSOLE_ROM_SERIAL_PORT_NUM=3
```
