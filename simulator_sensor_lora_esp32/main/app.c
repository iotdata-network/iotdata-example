// -----------------------------------------------------------------------------------------------------------------------------------------
// -----------------------------------------------------------------------------------------------------------------------------------------

/*
 * IoT Sensor Telemetry Protocol
 * Copyright(C) 2026 Matthew Gream (https://libiotdata.org)
 *
 * simulator_sensor_lora.c - multi-sensor simulator on esp32
 *
 * Simulates multiple sensors across 9 variant types and transmits
 * iotdata-encoded packets via the E22 LoRa radio module at
 * randomised intervals (5-15s).
 *
 * No real sensors — all readings are generated by
 * iotdata_variant_simulator.
 *
 * The LoRa module handles duty cycling.
 *
 * Depends upon EBYTE E22 connector
 * https://github.com/matthewgream/e22900t22u
 */

// -----------------------------------------------------------------------------------------------------------------------------------------
// -----------------------------------------------------------------------------------------------------------------------------------------

#include <stdbool.h>
#include <stdint.h>
#include <inttypes.h>
#include <stdio.h>
#include <stdlib.h>
#include <string.h>

#pragma GCC diagnostic push
#pragma GCC diagnostic ignored "-Wpedantic"
#pragma GCC diagnostic ignored "-Wnested-externs"
#pragma GCC diagnostic ignored "-Wredundant-decls"
#include "esp_log.h"
#include "esp_timer.h"
#include "esp_random.h"
#include "esp_cpu.h"
#include "esp_system.h"
#include "esp_task_wdt.h"
#include "esp_mac.h"
#include "rom/ets_sys.h"
#include "driver/gpio.h"
#include "driver/uart.h"
#include "freertos/FreeRTOS.h"
#include "freertos/task.h"
#pragma GCC diagnostic pop

/*
 * Every cooperative wait in this app funnels through __SLEEP_MS — directly, or
 * via __sleep_ms() which the e22 driver calls (its AUX wait loop and serial read
 * timeouts are sleep-based, not busy loops). Patting the Task Watchdog Timer here
 * therefore feeds it from within any blocking-but-yielding wait, so the TWDT only
 * fires on a genuine no-yield hang. Long sleeps are chunked so even a single
 * multi-second delay keeps patting inside the timeout window.
 */
#define __WDT_FEED_MS 1000U
#define __SLEEP_MS(ms) \
    do { \
        uint32_t __wdt_remain = (uint32_t)(ms); \
        do { \
            const uint32_t __wdt_chunk = __wdt_remain < __WDT_FEED_MS ? __wdt_remain : __WDT_FEED_MS; \
            (void)esp_task_wdt_reset(); \
            vTaskDelay(pdMS_TO_TICKS(__wdt_chunk)); \
            __wdt_remain -= __wdt_chunk; \
        } while (__wdt_remain > 0); \
    } while (0)

#define __MILLIS() ((uint32_t)(esp_timer_get_time() / 1000))

static inline uint32_t __JITTER(void) {
    uint32_t acc = 0;
    for (int i = 0; i < 256; i++) {
        const uint32_t a = esp_cpu_get_cycle_count();
        ets_delay_us(1);
        const uint32_t b = esp_cpu_get_cycle_count();
        acc ^= (b - a);
        acc = (acc << 1) | (acc >> 31); // rotate
    }
    return acc;
}

#define __RANDOM()        (__JITTER() ^ (uint32_t)esp_timer_get_time() ^ (uint32_t)esp_random())

// -----------------------------------------------------------------------------------------------------------------------------------------
// -----------------------------------------------------------------------------------------------------------------------------------------

#define STARTUP_DELAY_MS  (5 * 1000)
#define RSSI_INTERVAL_MS  (5 * 1000)
#define POLL_INTERVAL_MS  100 /* simulator poll granularity */
#define STATUS_EVERY_N_TX 50  /* print status every N transmissions */

// -----------------------------------------------------------------------------------------------------------------------------------------
// EBYTE E22-xxxTxx DIP module GPIO and UART configuration
// -----------------------------------------------------------------------------------------------------------------------------------------

#define PIN_E22_M0        GPIO_NUM_5 /* E22 pin (1) */
#define PIN_E22_M1        GPIO_NUM_6 /* E22 pin (2) */
#define PIN_E22_RXD       GPIO_NUM_7 /* E22 pin (3) ESP TX -> module RXD */
#define PIN_E22_TXD       GPIO_NUM_8 /* E22 pin (4) module TXD -> ESP RX */
#define PIN_E22_AUX       GPIO_NUM_9 /* E22 pin (5) */
#define PIN_E22_VCC                  /* E22 pin (6) */
#define PIN_E22_GND                  /* E22 pin (7) */

#define E22_UART          UART_NUM_1
#define E22_UART_BUF_SIZE 512

// -----------------------------------------------------------------------------------------------------------------------------------------
// -----------------------------------------------------------------------------------------------------------------------------------------

static const char *__tag_app = "app";

// -----------------------------------------------------------------------------------------------------------------------------------------
// -----------------------------------------------------------------------------------------------------------------------------------------

/*
 * e22xxxtxx.h builds multi-part output lines (no trailing \n on some calls),
 * so we use printf rather than ESP_LOG which adds prefixes and newlines.
 */
static bool debug_e22 = false;
#define PRINTF_DEBUG(fmt, ...) \
    do { \
        if (debug_e22) \
            printf(fmt, ##__VA_ARGS__); \
    } while (0)
#define PRINTF_INFO  printf
#define PRINTF_ERROR printf

bool serial_connect(void) {
    const uart_config_t uart_config = {
        .baud_rate = 9600,
        .data_bits = UART_DATA_8_BITS,
        .parity = UART_PARITY_DISABLE,
        .stop_bits = UART_STOP_BITS_1,
        .flow_ctrl = UART_HW_FLOWCTRL_DISABLE,
        .source_clk = UART_SCLK_DEFAULT,
    };
    esp_err_t err;
    if ((err = uart_driver_install(E22_UART, E22_UART_BUF_SIZE, E22_UART_BUF_SIZE, 0, NULL, 0)) != ESP_OK) {
        ESP_LOGE(__tag_app, "uart_driver_install: %s", esp_err_to_name(err));
        return false;
    }
    if ((err = uart_param_config(E22_UART, &uart_config)) != ESP_OK) {
        ESP_LOGE(__tag_app, "uart_param_config: %s", esp_err_to_name(err));
        (void)uart_driver_delete(E22_UART);
        return false;
    }
    if ((err = uart_set_pin(E22_UART, PIN_E22_RXD, PIN_E22_TXD, UART_PIN_NO_CHANGE, UART_PIN_NO_CHANGE)) != ESP_OK) {
        ESP_LOGE(__tag_app, "uart_set_pin: %s", esp_err_to_name(err));
        (void)uart_driver_delete(E22_UART);
        return false;
    }
    return true;
}
void serial_disconnect(void) {
    (void)uart_driver_delete(E22_UART);
}
void serial_flush(void) {
    (void)uart_flush(E22_UART);
}
int serial_write(const uint8_t *buffer, const int length) {
    __SLEEP_MS(50);
    return uart_write_bytes(E22_UART, buffer, (size_t)length);
}
int serial_read(uint8_t *buffer, const int length, const uint32_t timeout_ms) {
    __SLEEP_MS(50);
    return uart_read_bytes(E22_UART, buffer, (size_t)length, pdMS_TO_TICKS(timeout_ms));
}

// -----------------------------------------------------------------------------------------------------------------------------------------
// EBYTE E22-xxxTxx software interface (DIP variant)
// -----------------------------------------------------------------------------------------------------------------------------------------

#define E22900T22_SUPPORT_MODULE_DIP
#undef E22900T22_SUPPORT_MODULE_USB
#include "e22xxxtxx.h"
inline void __sleep_ms(const uint32_t ms) {
    __SLEEP_MS(ms);
}

static void e22_gpio_init(void) {
    (void)gpio_set_direction(PIN_E22_M0, GPIO_MODE_OUTPUT);
    (void)gpio_set_level(PIN_E22_M0, 1);
    (void)gpio_set_direction(PIN_E22_M1, GPIO_MODE_OUTPUT);
    (void)gpio_set_level(PIN_E22_M1, 1);
    (void)gpio_set_direction(PIN_E22_AUX, GPIO_MODE_INPUT);
    (void)gpio_pullup_en(PIN_E22_AUX);
}
static void e22_set_pin_mx(const bool pin_m0, const bool pin_m1) {
    (void)gpio_set_level(PIN_E22_M0, pin_m0 ? 1 : 0);
    (void)gpio_set_level(PIN_E22_M1, pin_m1 ? 1 : 0);
}
static bool e22_get_pin_aux(void) {
    return gpio_get_level(PIN_E22_AUX) == 1;
}
static e22900t22_config_t e22_config = {
    .address = 0x0008,
    .network = 0x00,
    .channel = 0x0A,
    .packet_size = E22900T22_CONFIG_PACKET_SIZE_DEFAULT,
    .packet_rate = E22900T22_CONFIG_PACKET_RATE_DEFAULT,
    .crypt = E22900T22_CONFIG_CRYPT_DEFAULT,
    .wor_enabled = E22900T22_CONFIG_WOR_ENABLED_DEFAULT,
    .wor_cycle = E22900T22_CONFIG_WOR_CYCLE_DEFAULT,
    .transmit_power = E22900T22_CONFIG_TRANSMIT_POWER_DEFAULT,
    .transmission_method = E22900T22_CONFIG_TRANSMISSION_METHOD_DEFAULT,
    .relay_enabled = E22900T22_CONFIG_RELAY_ENABLED_DEFAULT,
    .listen_before_transmit = true, // XXX
    .rssi_packet = true,
    .rssi_channel = true,
    .read_timeout_command = E22900T22_CONFIG_READ_TIMEOUT_COMMAND_DEFAULT,
    .read_timeout_packet = E22900T22_CONFIG_READ_TIMEOUT_PACKET_DEFAULT,
    .set_pin_mx = e22_set_pin_mx,
    .get_pin_aux = e22_get_pin_aux,
    .debug = false,
};

// -----------------------------------------------------------------------------------------------------------------------------------------
// iotdata — variant suite + simulator (unity build, encode-only)
// -----------------------------------------------------------------------------------------------------------------------------------------

/*
 * Strip everything except the encoder for minimal ESP32 build:
 *   - NO_DECODE:  no decoder (encoder-only)
 *   - NO_JSON:    no cJSON dependency
 *   - NO_DUMP:    no dump output
 *   - NO_PRINT:   no print output
 *   - NO_FLOATING: iotdata_float_t = int32_t (value * 100)
 *
 * The simulator's _to_temp/_to_speed/_to_dose helpers handle the
 * conversion from internal centi-units to iotdata_float_t correctly
 * under NO_FLOATING (they pass centi-values directly).
 */
#define IOTSIM_NUM_SENSORS 8   /* 8 sensors/board — keeps the shared channel sane with 4 boards */
#define IOTSIM_TX_MIN_MS 20000 /* 20s min interval (rate halved for 4-board coexistence) */
#define IOTSIM_TX_MAX_MS 40000 /* 40s max interval */
#define IOTDATA_NO_DECODE
#define IOTDATA_NO_JSON
#define IOTDATA_NO_DUMP
#define IOTDATA_NO_PRINT
#define IOTDATA_NO_FLOATING
#include "iotdata_variant_simulator.h"
#include "iotdata_variant_simulator.c"
#include "iotdata.c"

// -----------------------------------------------------------------------------------------------------------------------------------------
// -----------------------------------------------------------------------------------------------------------------------------------------

static uint32_t tx_count = 0, tx_errors = 0;

static void transmit_packet(const iotsim_packet_t *pkt) {

    static char hex[512];
    hex[0] = '\0';
    for (size_t i = 0, o = 0; i < pkt->len && o < (sizeof(hex) - 1); i++)
        o += (size_t)snprintf(&hex[o], (sizeof(hex) - o) - 1, "%02" PRIX8, pkt->buf[i]);
    ESP_LOGI(__tag_app, "device: e22 tx #%06" PRIu32 ": stn=%-4" PRIu16 " %-18s seq=%06" PRIu16 " len=%-2" PRIu16 " hex=%s", tx_count, pkt->station_id, iotdata_vsuite_name(pkt->variant), pkt->sequence, (uint16_t)pkt->len, hex);

    if (device_packet_write((const unsigned char *)pkt->buf, (int)pkt->len))
        tx_count++;
    else {
        tx_errors++;
        ESP_LOGE(__tag_app, "device: e22 tx device_packet_write failed (errors=%" PRIu32 ")", tx_errors);
    }
}

// -----------------------------------------------------------------------------------------------------------------------------------------
// -----------------------------------------------------------------------------------------------------------------------------------------

static const char *reset_reason_str(esp_reset_reason_t r) {
    switch (r) {
    case ESP_RST_POWERON:   return "POWERON (cold boot / power cycle)";
    case ESP_RST_EXT:       return "EXT (external reset pin)";
    case ESP_RST_SW:        return "SW (esp_restart / software)";
    case ESP_RST_PANIC:     return "PANIC (exception/abort crash)";
    case ESP_RST_INT_WDT:   return "INT_WDT (interrupt watchdog)";
    case ESP_RST_TASK_WDT:  return "TASK_WDT (task watchdog)";
    case ESP_RST_WDT:       return "WDT (other watchdog)";
    case ESP_RST_DEEPSLEEP: return "DEEPSLEEP (wake from deep sleep)";
    case ESP_RST_BROWNOUT:  return "BROWNOUT (power dip — check USB/cable/supply)";
    case ESP_RST_SDIO:      return "SDIO";
    case ESP_RST_USB:       return "USB (reset over USB peripheral)";
    case ESP_RST_JTAG:      return "JTAG";
    default:                return "UNKNOWN";
    }
}

bool app_exec(void) {

    ESP_LOGI(__tag_app, "iotdata multi-sensor simulator transmitter");

    const esp_reset_reason_t reset_reason = esp_reset_reason();
    ESP_LOGI(__tag_app, "boot: reset_reason=%d %s", (int)reset_reason, reset_reason_str(reset_reason));

    /* --- Hardware init --- */
    e22_gpio_init();
    if (!serial_connect()) {
        ESP_LOGE(__tag_app, "serial_connect failed");
        return false;
    }
    if (!device_connect(E22900T22_MODULE_DIP, &e22_config)) {
        ESP_LOGE(__tag_app, "device_connect failed");
        return false;
    }
    ESP_LOGI(__tag_app, "device: e22 connected");
    if (!(device_mode_config() && device_info_read() && device_config_read_and_update() && device_mode_transfer())) {
        ESP_LOGE(__tag_app, "device_mode/info/config/mode failed");
        return false;
    }
    ESP_LOGI(__tag_app, "device: e22 configured, transfer mode active");

    /* --- Simulator init --- Identity comes from the factory MAC so each board is
       unique AND stable across reboots: a per-board station_base (disjoint ID band)
       and a fixed seed (so each board's station->variant map never changes). Flash
       the same firmware to every board; they self-separate on air. */
    uint8_t mac[6] = { 0 };
    (void)esp_efuse_mac_get_default(mac);
    const uint32_t mac32 = ((uint32_t)mac[2] << 24) | ((uint32_t)mac[3] << 16) | ((uint32_t)mac[4] << 8) | mac[5];
    const uint32_t seed = mac32 ? mac32 : 0xDEADBEEFU;
    const uint16_t station_base = (uint16_t)((mac32 % 8000U) * 8U); /* 8-wide band: stations base+1..base+IOTSIM_NUM_SENSORS */
    const uint32_t t0 = __MILLIS();
    static iotsim_t sim; // too large for stack
    iotsim_init(&sim, seed, t0, station_base);
    ESP_LOGI(__tag_app, "board: mac=%02X:%02X:%02X:%02X:%02X:%02X seed=%08" PRIX32 " stations=%" PRIu16 "-%" PRIu16, (unsigned)mac[0], (unsigned)mac[1], (unsigned)mac[2], (unsigned)mac[3], (unsigned)mac[4], (unsigned)mac[5], seed, (uint16_t)(station_base + 1), (uint16_t)(station_base + IOTSIM_NUM_SENSORS));
    ESP_LOGI(__tag_app, "simulator: sensors=%d, tx_interval=%u-%us", IOTSIM_NUM_SENSORS, (unsigned)(IOTSIM_TX_MIN_MS / 1000), (unsigned)(IOTSIM_TX_MAX_MS / 1000));
    for (int i = 0; i < IOTSIM_NUM_SENSORS; i++) {
        const iotsim_sensor_t *s = iotsim_sensor(&sim, i);
        ESP_LOGI(__tag_app, "  [%2d] %-18s stn=%-4" PRIu16 " bat=%" PRIu8 "%%", i, iotdata_vsuite_name(s->variant), s->station_id, s->battery);
    }

    /* --- Application loop — poll simulator, transmit when ready --- */
    int rssi_channel_dbm = -100;
    uint32_t rssi_time_last = 0, tx_count_last = 0;
    for (;;) {
        if (__MILLIS() >= rssi_time_last + RSSI_INTERVAL_MS) {
            rssi_time_last = __MILLIS();
            unsigned char rssi_raw;
            if (device_channel_rssi_read(&rssi_raw))
                rssi_channel_dbm = get_rssi_dbm(rssi_raw);
        }
        iotsim_packet_t pkt;
        while (iotsim_poll(&sim, __MILLIS(), &pkt)) {
            transmit_packet(&pkt);
            __SLEEP_MS(5);
        }
        if (tx_count >= tx_count_last + STATUS_EVERY_N_TX) {
            tx_count_last = tx_count;
            ESP_LOGI(__tag_app, "status: tx=%" PRIu32 " errors=%" PRIu32 " rssi=%d dBm uptime=%" PRIu32 "s", tx_count, tx_errors, rssi_channel_dbm, (__MILLIS() - t0) / 1000);
        }
        __SLEEP_MS(POLL_INTERVAL_MS);
    }

    return true;
}

void app_main(void) {

    setbuf(stdout, NULL);

    /*
     * Subscribe this task to the Task Watchdog Timer (the TWDT itself is started
     * at boot via CONFIG_ESP_TASK_WDT_INIT). From here on __SLEEP_MS pats it; if
     * the app stops yielding for CONFIG_ESP_TASK_WDT_TIMEOUT_S the TWDT panics and
     * the chip resets (CONFIG_ESP_TASK_WDT_PANIC), recovering a wedged unattended
     * sensor. The boot path already logs ESP_RST_TASK_WDT as the reset reason.
     */
    const esp_err_t wdt_err = esp_task_wdt_add(NULL);
    if (wdt_err != ESP_OK)
        ESP_LOGE(__tag_app, "task watchdog: subscribe failed: %s", esp_err_to_name(wdt_err));
    else
        ESP_LOGI(__tag_app, "task watchdog: subscribed (timeout=%ds)", CONFIG_ESP_TASK_WDT_TIMEOUT_S);

    __SLEEP_MS(STARTUP_DELAY_MS);
    if (!app_exec()) {
        ESP_LOGE(__tag_app, "failed");
        __SLEEP_MS(30 * 1000);
        esp_restart();
    }
}

// -----------------------------------------------------------------------------------------------------------------------------------------
// -----------------------------------------------------------------------------------------------------------------------------------------
