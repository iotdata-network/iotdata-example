// -----------------------------------------------------------------------------------------------------------------------------------------
// -----------------------------------------------------------------------------------------------------------------------------------------

/*
 * IoT Sensor Telemetry Protocol
 * Copyright(C) 2026 Matthew Gream (https://libiotdata.org)
 *
 * simulator_sensor_lora_esp32 - multi-sensor simulator on esp32
 *
 * Simulates multiple sensors (a per-board palette of the variant suite, MAC-seeded so a fleet spreads the suite out) and transmits
 * iotdata-encoded packets via the E22 LoRa radio module at randomised intervals.
 *
 * No real sensors — all readings are generated by iotdata_variant_simulator.
 */

// -----------------------------------------------------------------------------------------------------------------------------------------
// -----------------------------------------------------------------------------------------------------------------------------------------

#pragma GCC diagnostic push
#pragma GCC diagnostic ignored "-Wpedantic"
#pragma GCC diagnostic ignored "-Wnested-externs"
#pragma GCC diagnostic ignored "-Wredundant-decls"

#include <stdbool.h>
#include <stdint.h>
#include <inttypes.h>
#include <stdio.h>
#include <stdlib.h>
#include <string.h>

#include "esp_log.h"
#include "esp_mac.h"
#include "freertos/FreeRTOS.h"
#include "freertos/task.h"

#pragma GCC diagnostic pop

// -----------------------------------------------------------------------------------------------------------------------------------------
// -----------------------------------------------------------------------------------------------------------------------------------------

#include "iotdata_config.h"
#include "iotdata_hardware.h"

// -----------------------------------------------------------------------------------------------------------------------------------------
// CONFIGURABLES
// -----------------------------------------------------------------------------------------------------------------------------------------

#define POLL_INTERVAL_MS   100 /* simulator poll granularity */
#define STATUS_EVERY_N_TX  50  /* print status every N transmissions */
#define TEST_FIXED_PAYLOAD 0   /* PHY-crack scaffold, DISABLED. Set to 1 to bypass the simulator and transmit a fixed known 16-byte ramp (see app_exec) — useful for sniffing/decoding the raw LoRa PHY. */

// -----------------------------------------------------------------------------------------------------------------------------------------
// -----------------------------------------------------------------------------------------------------------------------------------------

static const char *__tag_app = "app";

// -----------------------------------------------------------------------------------------------------------------------------------------
// -----------------------------------------------------------------------------------------------------------------------------------------

#define PIN_DEVICE_UART_TX  PIN_E22_RXD
#define PIN_DEVICE_UART_RX  PIN_E22_TXD
#define PIN_DEVICE_LORA_AUX PIN_E22_AUX
#define PIN_DEVICE_LORA_M0  PIN_E22_M0
#define PIN_DEVICE_LORA_M1  PIN_E22_M1

#include "d_platform_esp32.h"
#include "d_common.h"
#include "d_hardware_gpio.h"
#include "d_hardware_uart.h"
#include "d_interface_e22900t22.h"

static const lora_config_t lora_cfg = {
    .e22_address = IOTDATA_CONFIG_LORA_ADDRESS,
    .e22_network = IOTDATA_CONFIG_LORA_NETWORK,
    .channel = IOTDATA_CONFIG_LORA_CHANNEL,
    .transmit_power = 22,  // dBm
    .air_data_rate = 2400, // bps
    .packet_size = 240,
    .listen_before_transmit = true,
    .crypt = 0x0000,
    .rssi_packet = true,
    .rssi_channel = false,
};

// -----------------------------------------------------------------------------------------------------------------------------------------
// iotdata — variant suite + simulator (unity build, encode-only)
// -----------------------------------------------------------------------------------------------------------------------------------------

/*
 * Strip everything except the encoder for minimal ESP32 build:
 *   - NO_JSON:    no cJSON dependency
 *   - NO_DUMP:    no dump output
 *   - NO_PRINT:   no print output
 *   - NO_FLOATING: iotdata_float_t = int32_t (value * 100)
 */
#define IOTDATA_NO_JSON
#define IOTDATA_NO_DUMP
#define IOTDATA_NO_PRINT
#define IOTDATA_NO_FLOATING
#include "iotdata_variant_simulator.h"
#include "iotdata_variant_simulator.c"
#include "iotdata.c"
#include "iotdata_node.h"
#include "iotdata_node_endpoint.h"

// -----------------------------------------------------------------------------------------------------------------------------------------
// Blackbox diagnostics
// -----------------------------------------------------------------------------------------------------------------------------------------

#if IOTDATA_CONFIG_BLACKBOX
#ifndef IOTDATA_BLACKBOX_POOL_SZ
#define IOTDATA_BLACKBOX_POOL_SZ 1024u
#endif
#if IOTDATA_CONFIG_BLACKBOX >= 2
#define BLACKBOX_PERSIST BLACKBOX_PERSIST_ESP_FLASH
#else
#define BLACKBOX_PERSIST BLACKBOX_PERSIST_NONE
#endif
#define IOTDATA_BLACKBOX_IMPLEMENTATION
#include "iotdata_blackbox.h"
static RTC_NOINIT_ATTR char blackbox_pool[IOTDATA_BLACKBOX_POOL_SZ];
static blackbox_handle_t blackbox;
static const blackbox_config_t blackbox_config = {
    .pool = blackbox_pool,
    .pool_sz = sizeof(blackbox_pool),
    .flush = BLACKBOX_FLUSH_MANUAL, /* flushed explicitly after each event; a no-op under PERSIST_NONE */
    .persist_arg = "diag",          /* ESP_FLASH: the partition label; ignored by PERSIST_NONE */
    .enabled = true,                /* compiled in == collecting; the compile-time knob is the gate */
};
static void blackbox_start(const esp_reset_reason_t reason) {
    iotdata_blackbox_begin();
    if (blackbox_init(&blackbox, &blackbox_config) != 0) {
        ESP_LOGW(__tag_app, "blackbox: init failed -- diagnostics disabled");
        return;
    }
    (void)iotdata_blackbox_lifecycle(&blackbox, IOTDATA_BB_LC_BOOT, (uint8_t)reason);
    (void)blackbox_flush(&blackbox);
}
#define BLACKBOX_START(reason) blackbox_start((reason))
#define BLACKBOX_EVENT(ev, reason) \
    do { \
        (void)iotdata_blackbox_lifecycle(&blackbox, (ev), (uint8_t)(reason)); \
        (void)blackbox_flush(&blackbox); \
    } while (0)
#else
#define BLACKBOX_START(reason)     ((void)0)
#define BLACKBOX_EVENT(ev, reason) ((void)0)
#endif

// -----------------------------------------------------------------------------------------------------------------------------------------
// -----------------------------------------------------------------------------------------------------------------------------------------

static uint32_t tx_count = 0, tx_errors = 0;

// -----------------------------------------------------------------------------------------------------------------------------------------
// Node personality, one per simulated sensor
//
// A simulator is a fleet in one box, so each virtual sensor keeps its own receive window and they
// drift apart rather than all waking together -- which is what a real fleet does, and the thing
// worth simulating.
//
// One difference from the real sensor: it appends RECEIVE to the telemetry frame it was already
// sending (two bytes), whereas here the frames are built inside the simulator library, so the
// advertisement goes out as a frame of its own immediately afterwards. Same moment, same effect on
// whoever is holding a command -- just an extra frame of airtime that a real node would not spend.
// -----------------------------------------------------------------------------------------------------------------------------------------

static iotsim_t g_sim;
static idep_node_t sim_nodes[IOTDATA_CONFIG_SIMULATOR_NUM_SENSORS];

static void sim_node_status(const uint16_t station, iotdata_kvr_t *const kv) {
    iotdata_kvr_add_u32(kv, IOTDATA_NODE_STATUS_UPTIME, (uint32_t)(__MILLIS() / 1000));
    iotdata_kvr_add_u8(kv, IOTDATA_NODE_STATUS_REASON, IOTDATA_NODE_REASON_UNKNOWN);
    iotdata_kvr_add_u32(kv, IOTDATA_NODE_STATUS_HEAP_FREE, (uint32_t)esp_get_free_heap_size());
    for (int i = 0; i < (int)(sizeof(sim_nodes) / sizeof(sim_nodes[0])); i++)
        if (sim_nodes[i].station_id == station) {
            const iotsim_sensor_t *const s = iotsim_sensor(&g_sim, i);
            if (s != NULL)
                iotdata_kvr_add_u16(kv, IOTDATA_NODE_STATUS_SUPPLY, (uint16_t)(s->battery * 30u)); /* % -> a plausible mV */
            break;
        }
}

static bool sim_node_tx(const uint8_t *const packet, const size_t len) {
    if (lora_write_complete(packet, len, /*wait_complete=*/true) == ESP_OK) {
        tx_count++;
        return true;
    } else {
        tx_errors++;
        return false;
    }
}

static const idep_version_t sim_version = {
    .firmware = "0.01",
    .application = "iotdata_simulator",
    .platform = CONFIG_IDF_TARGET,
    .build = __DATE__,
};

/*
 * A simulator is a test instrument, so it listens all the time: a command aimed at one of its
 * sensors is acted on when it is sent, not six hours later. Nothing is advertised -- a DOWN frame
 * is transmitted before it is held, so an always-listening node needs no invitation.
 *
 * SIMULATE_RECEIVE_ALWAYS=0 (see the Makefile) makes a board imitate a real sleeping sensor
 * instead, windows and advertisements and all, which is the only way to exercise that path on the
 * bench. When CONFIG becomes settable over the air this stops being a build-time choice.
 */
#ifndef SIMULATE_RECEIVE_ALWAYS
#define SIMULATE_RECEIVE_ALWAYS 1
#endif

static const idep_config_t sim_cfg = {
    .version = &sim_version,
    .status = sim_node_status,
    .tx = sim_node_tx,
    .receive_always = (SIMULATE_RECEIVE_ALWAYS != 0),
    .receive_every_ms = IDEP_RECEIVE_EVERY_MS,
    .receive_window_ms = IDEP_RECEIVE_WINDOW_MS,
};

static void receive_packets(__attribute__((unused)) iotsim_t *const sim) {
    bool any_open = false;
    const uint32_t now = __MILLIS();
    for (int i = 0; i < (int)(sizeof(sim_nodes) / sizeof(sim_nodes[0])) && !any_open; i++)
        any_open = idep_window_active(&sim_cfg, &sim_nodes[i], now);
    if (!any_open)
        return;

    uint8_t buf[IDEP_PACKET_MAX];
    int len = 0, rssi_dbm = 0;
    /* 0ms first-byte timeout: this is a poll from the main loop, not a blocking receive. */
    while (lora_read(buf, sizeof(buf), &len, &rssi_dbm, 0) == ESP_OK && len > 0) {
        for (int i = 0; i < (int)(sizeof(sim_nodes) / sizeof(sim_nodes[0])); i++)
            if (idep_window_active(&sim_cfg, &sim_nodes[i], __MILLIS())) {
                bool reboot = false;
                if (idep_on_frame(&sim_cfg, &sim_nodes[i], buf, (size_t)len, &reboot))
                    ESP_LOGI(__tag_app, "node: stn=%" PRIu16 " acted on a downstream command", sim_nodes[i].station_id);
                if (reboot) {
                    ESP_LOGW(__tag_app, "node: stn=%" PRIu16 " REBOOT commanded -- restarting", sim_nodes[i].station_id);
                    BLACKBOX_EVENT(IOTDATA_BB_LC_STOP, 0);
                    __SLEEP_MS(200);
                    esp_restart();
                }
            }
        len = 0;
    }

    for (int i = 0; i < (int)(sizeof(sim_nodes) / sizeof(sim_nodes[0])); i++)
        if (sim_nodes[i].window_open && !idep_window_active(&sim_cfg, &sim_nodes[i], __MILLIS())) {
            idep_window_end(&sim_nodes[i]);
            ESP_LOGI(__tag_app, "node: stn=%" PRIu16 " receive window closed", sim_nodes[i].station_id);
        }
}

// -----------------------------------------------------------------------------------------------------------------------------------------

static void transmit_packet(const iotsim_packet_t *pkt) {
    static char hex[512];
    hex[0] = '\0';
    for (size_t i = 0, o = 0; i < pkt->len && o < (sizeof(hex) - 1); i++)
        o += (size_t)snprintf(&hex[o], (sizeof(hex) - o) - 1, "%02" PRIX8, pkt->buf[i]);
    ESP_LOGI(__tag_app, "device: e22 tx #%06" PRIu32 ": stn=%-4" PRIu16 " %-18s seq=%06" PRIu16 " len=%-2" PRIu16 " hex=%s", tx_count, pkt->station_id, iotdata_vsuite_name(pkt->variant), pkt->sequence, (uint16_t)pkt->len, hex);
    if (lora_write_complete(pkt->buf, pkt->len, /*wait_complete=*/true) == ESP_OK)
        tx_count++;
    else {
        tx_errors++;
        ESP_LOGE(__tag_app, "device: e22 tx lora_write_complete failed (errors=%" PRIu32 ")", tx_errors);
    }
}

static void transmit_packets(iotsim_t *const sim) {
    iotsim_packet_t pkt;
    while (iotsim_poll(sim, __MILLIS(), &pkt)) {
        transmit_packet(&pkt);
        __SLEEP_MS(5);
        const int idx = pkt.sensor_index;
        if (idx >= 0 && idx < (int)(sizeof(sim_nodes) / sizeof(sim_nodes[0])) && idep_window_pending(&sim_nodes[idx])) {
            sim_nodes[idx].sequence = (uint16_t)(pkt.sequence + 1u);
            if (idep_receive_announce(&sim_cfg, &sim_nodes[idx])) {
                idep_window_begin(&sim_cfg, &sim_nodes[idx], __MILLIS());
                ESP_LOGI(__tag_app, "node: stn=%" PRIu16 " receive window open for %ums", sim_nodes[idx].station_id, (unsigned)IDEP_RECEIVE_WINDOW_MS);
            }
            __SLEEP_MS(5);
        }
    }
}

// -----------------------------------------------------------------------------------------------------------------------------------------
// -----------------------------------------------------------------------------------------------------------------------------------------

bool app_exec(void) {

    ESP_LOGI(__tag_app, "iotdata multi-sensor simulator transmitter");

    const esp_reset_reason_t reset_reason = esp_reset_reason();
    ESP_LOGI(__tag_app, "boot: reset_reason=%d %s", (int)reset_reason, reset_reason_str(reset_reason));

    BLACKBOX_START(reset_reason);

    /* --- Hardware init --- */
    esp_err_t lerr;
    if ((lerr = lora_setup(&lora_cfg)) != ESP_OK) {
        ESP_LOGE(__tag_app, "device: e22 setup failed: %s", esp_err_to_name(lerr));
        BLACKBOX_EVENT(IOTDATA_BB_LC_ERROR, 2);
        return false;
    }
    ESP_LOGI(__tag_app, "device: e22 configured");
    if ((lerr = lora_start()) != ESP_OK) {
        ESP_LOGE(__tag_app, "device: e22 start failed: %s", esp_err_to_name(lerr));
        BLACKBOX_EVENT(IOTDATA_BB_LC_ERROR, 3);
        return false;
    }
    ESP_LOGI(__tag_app, "device: e22 configured, transfer mode active");
    BLACKBOX_EVENT(IOTDATA_BB_LC_START, 0);

    /* --- Simulator init --- Identity comes from the factory MAC so each board is
       unique AND stable across reboots: a per-board station_base (disjoint ID band)
       and a fixed seed (so each board's station->variant map never changes). Flash
       the same firmware to every board; they self-separate on air. */
    uint8_t mac[6] = { 0 };
    (void)esp_efuse_mac_get_default(mac);
    const uint32_t mac32 = ((uint32_t)mac[2] << 24) | ((uint32_t)mac[3] << 16) | ((uint32_t)mac[4] << 8) | mac[5];
    const uint32_t seed = mac32 ? mac32 : 0xDEADBEEFU;
    const uint16_t nbands = (uint16_t)(IOTDATA_STATION_ASSIGNABLE_MAX / IOTDATA_CONFIG_SIMULATOR_NUM_SENSORS); /* 4094/8 = 511 */
    const uint16_t station_base = (uint16_t)((mac32 % nbands) * (uint32_t)IOTDATA_CONFIG_SIMULATOR_NUM_SENSORS);
    const uint32_t t0 = __MILLIS();
    iotsim_init(&g_sim, seed, t0, station_base);
    ESP_LOGI(__tag_app, "board: mac=%02X:%02X:%02X:%02X:%02X:%02X seed=%08" PRIX32 " stations=%" PRIu16 "-%" PRIu16, (unsigned)mac[0], (unsigned)mac[1], (unsigned)mac[2], (unsigned)mac[3], (unsigned)mac[4], (unsigned)mac[5], seed,
             (uint16_t)(station_base + 1), (uint16_t)(station_base + IOTDATA_CONFIG_SIMULATOR_NUM_SENSORS));
    ESP_LOGI(__tag_app, "simulator: sensors=%d, types/board=%d, tx_interval=%u-%us", IOTDATA_CONFIG_SIMULATOR_NUM_SENSORS, IOTDATA_CONFIG_SIMULATOR_VARIANT_TYPES, (unsigned)(IOTDATA_CONFIG_SIMULATOR_TX_MIN_MS / 1000),
             (unsigned)(IOTDATA_CONFIG_SIMULATOR_TX_MAX_MS / 1000));
    for (int i = 0; i < (int)(sizeof(sim_nodes) / sizeof(sim_nodes[0])); i++) {
        const iotsim_sensor_t *s = iotsim_sensor(&g_sim, i);
        idep_node_init(&sim_nodes[i], s->station_id);
        sim_nodes[i].elapsed_ms = (uint32_t)((uint64_t)IDEP_RECEIVE_EVERY_MS * (uint32_t)i / IOTDATA_CONFIG_SIMULATOR_NUM_SENSORS);
        ESP_LOGI(__tag_app, "  [%2d] %-18s stn=%-4" PRIu16 " bat=%" PRIu8 "%%", i, iotdata_vsuite_name(s->variant), s->station_id, s->battery);
    }
    if (sim_cfg.receive_always)
        ESP_LOGI(__tag_app, "node: receiver always on (no advertisement needed), per sensor");
    else
        ESP_LOGI(__tag_app, "node: receive window %us every %uh, per sensor", (unsigned)(IDEP_RECEIVE_WINDOW_MS / 1000), (unsigned)(IDEP_RECEIVE_EVERY_MS / 3600000u));

    /* --- Application loop --- */
    uint32_t tx_count_last = 0, window_last_ms = __MILLIS();
    for (;;) {
        const uint32_t now = __MILLIS(), delta = now - window_last_ms;
        window_last_ms = now;
        for (int i = 0; i < (int)(sizeof(sim_nodes) / sizeof(sim_nodes[0])); i++)
            (void)idep_window_advance(&sim_cfg, &sim_nodes[i], delta);

        transmit_packets(&g_sim);
        receive_packets(&g_sim);

        if (tx_count >= tx_count_last + STATUS_EVERY_N_TX) {
            tx_count_last = tx_count;
            ESP_LOGI(__tag_app, "status: tx=%" PRIu32 " errors=%" PRIu32 " uptime=%" PRIu32 "s", tx_count, tx_errors, (__MILLIS() - t0) / 1000);
        }

        __SLEEP_MS(POLL_INTERVAL_MS);
    }

    return true;
}

void app_main(void) {

    setbuf(stdout, NULL);

    const esp_err_t wdt_err = esp_task_wdt_add(NULL);
    if (wdt_err != ESP_OK)
        ESP_LOGE(__tag_app, "task watchdog: subscribe failed: %s", esp_err_to_name(wdt_err));
    else
        ESP_LOGI(__tag_app, "task watchdog: subscribed (timeout=%ds)", CONFIG_ESP_TASK_WDT_TIMEOUT_S);

    if (!app_exec()) {
        ESP_LOGE(__tag_app, "failed");
        BLACKBOX_EVENT(IOTDATA_BB_LC_STOP, 0);
        __SLEEP_MS(30 * 1000);
        esp_restart();
    }
}

// -----------------------------------------------------------------------------------------------------------------------------------------
// -----------------------------------------------------------------------------------------------------------------------------------------
